## bsp/stm32/encortec/application/board/Kconfig
```kconfig
menu "Encortec Application Config"

menu "Logging configuration"

    config APP_USING_LOG
        bool "Enable application log printing"
        if APP_USING_LOG
            menuconfig APP_LOG_PRINT_CHANNEL
                bool "Select log printing channel"
                default y
                if APP_LOG_PRINT_CHANNEL
                    config APP_LOG_PRINT_TO_UART
                        bool "Print log to UART"
                        default y
                    config APP_LOG_PRINT_TO_FILE
                        bool "Print log to file"
                        default n
                endif

            menuconfig APP_LOG_LEVEL
                bool "Select log printing level"
                default y
                if APP_LOG_LEVEL
                    config APP_LOG_LEVEL_DBG
                        bool "Log level: debug"
                        default y
                    config APP_LOG_LEVEL_INF
                        bool "Log level: info"
                        default n
                    config APP_LOG_LEVEL_WAR
                        bool "Log level: warning"
                        default n
                    config APP_LOG_LEVEL_ERR
                        bool "Log level: error"
                        default n
                endif

            config APP_LOG_USING_TS
                bool "Enable time stamp in log text"
                default n

            config APP_LOG_BUF_SIZE
                int "Set log buffer size"
                default 512
        endif

endmenu

menu "STM32 Platform"

    choice
        prompt "Select STM32 Platform"
        default SOC_STM32U575VI

        config SOC_STM32U545RE
            bool "SOC_STM32U545RE"
            select SOC_SERIES_STM32U5
            select RT_USING_COMPONENTS_INIT
            select RT_USING_USER_MAIN
            default n

        config SOC_STM32U535VE
            bool "SOC_STM32U535VE"
            select SOC_SERIES_STM32U5
            select RT_USING_COMPONENTS_INIT
            select RT_USING_USER_MAIN
            default n

        config SOC_STM32U575VI
            bool "SOC_STM32U575VI"
            select SOC_SERIES_STM32U5
            select RT_USING_COMPONENTS_INIT
            select RT_USING_USER_MAIN
            default y

    endchoice

endmenu

endmenu
```

## bsp/stm32/encortec/bootloader/board/Kconfig
```kconfig
menu "Hardware Drivers Config"

menu "Onboard Peripheral Drivers"

    config  BSP_USING_NAND_FLASH
        bool "Enable Nand Falsh"
        default n

endmenu

menu "On-chip Peripheral Drivers"

    config BSP_USING_GPIO
        bool "Enable GPIO"
        select RT_USING_PIN
        default y

    menuconfig BSP_USING_UART
        bool "Enable UART"
        default y
        select RT_USING_SERIAL
        if BSP_USING_UART
            config BSP_USING_UART1
                bool "Enable UART1"
                default y

            config BSP_UART1_RX_USING_DMA
                bool "Enable UART1 RX DMA"
                depends on BSP_USING_UART1 && RT_SERIAL_USING_DMA
                default n

            config BSP_USING_UART3
                bool "Enable UART3"
                default y

            config BSP_USING_UART4
                bool "Enable UART4"
                default y

            config BSP_USING_UART5
                bool "Enable UART5"
                default y

            config BSP_USING_LPUART1
                bool "Enable LPUART1"
                default y

            config BSP_LPUART1_RX_USING_DMA
                bool "Enable LPUART1 RX DMA"
                depends on BSP_USING_LPUART1 && RT_SERIAL_USING_DMA
                default n
        endif

    menuconfig BSP_USING_ADC
        bool "Enable ADC"
        default n
        # select RT_USING_ADC
        if BSP_USING_ADC
            config BSP_USING_ADC1
                bool "Enable ADC1"
                default n

            config BSP_USING_VERFBUF
                bool "Enable VERFBUF"
                default n
        endif

    menuconfig BSP_USING_PWM
        bool "Enable PWM"
        default n
        select RT_USING_PWM
        if BSP_USING_PWM

            menuconfig BSP_USING_PWM1
                bool "Enable timer1 output PWM"
                default n
                if BSP_USING_PWM1
                    config BSP_USING_PWM1_CH1
                        bool "Enable PWM1 channel1"
                        default n

                    config BSP_USING_PWM1_CH2
                        bool "Enable PWM1 channel2"
                        default n

                    config BSP_USING_PWM1_CH3
                        bool "Enable PWM1 channel3"
                        default n

                    config BSP_USING_PWM1_CH4
                        bool "Enable PWM1 channel4"
                        default n
                endif

            menuconfig BSP_USING_PWM4
                bool "Enable timer4 output PWM"
                default n
                if BSP_USING_PWM4
                    config BSP_USING_PWM4_CH1
                        bool "Enable PWM4 channel1"
                        default n

                    config BSP_USING_PWM4_CH2
                        bool "Enable PWM4 channel2"
                        default n

                    config BSP_USING_PWM4_CH3
                        bool "Enable PWM4 channel3"
                        default n

                    config BSP_USING_PWM4_CH4
                        bool "Enable PWM4 channel4"
                        default n
                endif
        endif

    menuconfig BSP_USING_SPI
        bool "Enable SPI BUS"
        default n
        select RT_USING_SPI
        if BSP_USING_SPI
            config BSP_USING_SPI1
                bool "Enable SPI1 BUS"
                default n

            config BSP_SPI1_TX_USING_DMA
                bool "Enable SPI1 TX DMA"
                depends on BSP_USING_SPI1
                default n

            config BSP_SPI1_RX_USING_DMA
                bool "Enable SPI1 RX DMA"
                depends on BSP_USING_SPI1
                default n
        endif

    menuconfig BSP_USING_I2C
        bool "Enable I2C BUS"
        default n
        select RT_USING_I2C
        select RT_USING_I2C_BITOPS
        select RT_USING_PIN
        if BSP_USING_I2C
            menuconfig BSP_USING_I2C1
                bool "Enable I2C1 BUS (software simulation)"
                default y
                if BSP_USING_I2C1
                    comment "Notice: PB8 --> 24; PB9 --> 25"
                    config BSP_I2C1_SCL_PIN
                        int "i2c1 scl pin number"
                        range 1 176
                        default 24
                    config BSP_I2C1_SDA_PIN
                        int "I2C1 sda pin number"
                        range 1 176
                        default 25
                endif
        endif

    menuconfig BSP_USING_ONCHIP_RTC
        bool "Enable ONCHIP RTC"
        default y
        select RT_USING_PIN
        if BSP_USING_ONCHIP_RTC
            config BSP_RTC_USING_LSI
                bool "Enable RTC USING LSI"
                default n
            config BSP_RTC_USING_LSE
                bool "Enable RTC USING LSE"
                default n
        endif

    source "$(BSP_DIR)/../libraries/HAL_Drivers/drivers/Kconfig"

endmenu

menu "Board extended module Drivers"

    config BSP_USING_DHARA
        bool "Enable dhara"
        default n

endmenu

endmenu
```

## bsp/stm32/stm32u535-st-nucleo/Kconfig
```kconfig
mainmenu "RT-Thread Configuration"

BSP_DIR := .

RTT_DIR := ../../..

PKGS_DIR := packages

config SOC_STM32U545RE
	bool "SOC_STM32U545RE"
	select SOC_SERIES_STM32U5
	select RT_USING_COMPONENTS_INIT
	select RT_USING_USER_MAIN
	default y

config BOARD_STM32U545_NUCLEO
	bool "BOARD_STM32U545_NUCLEO"
	select SOC_STM32U545RE
	select BOARD_SERIES_STM32_NUCLEO_64
	default y

config SOC_STM32U535RE
	bool "SOC_STM32U535RE"
	select SOC_SERIES_STM32U5
	select RT_USING_COMPONENTS_INIT
	select RT_USING_USER_MAIN
	default n

config BOARD_STM32U535_NUCLEO
	bool "BOARD_STM32U535_NUCLEO"
	select SOC_STM32U535RE
	select BOARD_SERIES_STM32_NUCLEO_64
	default n

source "$(RTT_DIR)/Kconfig"
osource "$PKGS_DIR/Kconfig"
rsource "../libraries/Kconfig"

if !RT_USING_NANO
rsource "board/Kconfig"
endif
```
